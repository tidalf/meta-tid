## conf/local.conf.sample
```bitbake
#MACHINE ??= 'udoo-quad'
DISTRO ?= 'poky'
#PACKAGE_CLASSES ?= "package_rpm"
EXTRA_IMAGE_FEATURES += "debug-tweaks"
USER_CLASSES ?= "buildstats image-mklibs image-prelink"
PATCHRESOLVE = "noop"
BB_DISKMON_DIRS = "\
    STOPTASKS,${TMPDIR},1G,100K \
    STOPTASKS,${DL_DIR},1G,100K \
    STOPTASKS,${SSTATE_DIR},1G,100K \
    ABORT,${TMPDIR},100M,1K \
    ABORT,${DL_DIR},100M,1K \
    ABORT,${SSTATE_DIR},100M,1K" 
CONF_VERSION = "1"
BOOTSCRIPTS = "env.txt"
BB_NUMBER_THREADS = '10'
PARALLEL_MAKE = '-j 10'
ENABLE_BINARY_LOCALE_GENERATION = "1"
##DL_DIR ?= "${BSPDIR}/downloads/"
ACCEPT_FSL_EULA = ""
DEFAULT_TIMEZONE="Europe/Berlin"
DISTRO_FEATURES_LIBC = "ipv4 ipv6 libc-backtrace libc-big-macros libc-bsd libc-cxx-tests libc-catgets libc-charsets libc-crypt \
               libc-crypt-ufc libc-db-aliases libc-envz libc-fcvt libc-fmtmsg libc-fstab libc-ftraverse \
               libc-getlogin libc-idn libc-inet libc-inet-anl libc-libm libc-locales libc-locale-code \
               libc-memusage libc-nis libc-nsswitch libc-rcmd libc-rtld-debug libc-spawn libc-streams libc-sunrpc \
               libc-utmp libc-utmpx libc-wordexp libc-posix-clang-wchar libc-posix-regexp libc-posix-regexp-glibc \
               libc-posix-wchar-io"
IMAGE_LINGUAS="fr-fr de-de "
GLIBC_GENERATE_LOCALES="all"
DISTRO_FEATURES_remove = " x11 wayland 3g nfc "
DISTRO_FEATURES_append = " pam "
PACKAGECONFIG_remove = " consolekit "
PREFERRED_PROVIDER_jpeg = "libjpeg-turbo"
PREFERRED_PROVIDER_jpeg-native = "libjpeg-turbo-native"
PREFERRED_PROVIDER_xbmc = "xbmc_13"
PREFERRED_PROVIDER_virtual/mesa = " gpu-viv-bin-mx6q "
PREFERRED_PROVIDER_virtual/egl = "gpu-viv-bin-mx6q "
# PREFERRED_VERSION_virtual/kernel = "3.10.17-4.0.1"
#PREFERRED_VERSION_firmware-imx = "3.0.35-4.0.0"
#PREFERRED_VERSION_v8 = "3.24.37"
#PREFERRED_VERSION_imx-vpu ="3.10.9-1.0.0" 
#PREFERRED_VERSION_libfslvpuwrap ="1.0.46" 
#PREFERRED_VERSION_gpu-viv-bin-mx6q ="3.10.9-1.0.0-hfp" 
#PREFERRED_VERSION_gpu-viv-g2d ="3.10.9-1.0.0" 
#PREFERRED_VERSION_imx-lib ="3.10.9-1.0.0" 
# INHERIT += "blacklist"

DISTRO_FEATURES_append = " systemd"
VIRTUAL-RUNTIME_init_manager = "systemd"
DISTRO_FEATURES_BACKFILL_CONSIDERED = "sysvinit"
SOC_IMAGE_INSTALL = " gpu-viv-bin-mx6q gpu-viv-g2d libsdl libfslvpuwrap xbmc"
IMAGE_ROOTFS_EXTRA_SPACE = "162144"
LICENSE_FLAGS_WHITELIST += " commercial oracle_java "

BB_NUMBER_THREADS = '12'
PARALLEL_MAKE = '-j 12'

##DL_DIR ?= "${BSPDIR}/downloads/"

#added by hob
PACKAGE_CLASSES = "package_rpm "

#added by hob
DL_DIR = "/home/tid/fsl-community-bsp/downloads/"

#added by hob
SSTATE_DIR = "/home/tid/fsl-community-bsp/build/sstate-cache"

#added by hob
SSTATE_MIRRORS = ""

#added by hob
INCOMPATIBLE_LICENSE = ""

#added by hob
SDKMACHINE = "x86_64"

#added by hob
http_proxy = ""

#added by hob
https_proxy = ""

#added by hob
ftp_proxy = ""

#added by hob
all_proxy = ""

#added by hob
CVS_PROXY_HOST = ""

#added by hob
CVS_PROXY_PORT = ""

#added by hob
MACHINE ?= "udoo-quad"

#added by hob
IMAGE_FSTYPES = "ext3 tar.bz2 sdcard"

#added by hob
LINGUAS_INSTALL = ""

#added by hob
IMAGE_EXTRA_SPACE = "80144"

#added by hob
TOOLCHAIN_BUILD = "False"
```
